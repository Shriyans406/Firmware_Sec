# file: secure_bootloader.ioc
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Mcu.Family=STM32F1
Mcu.Name=STM32F103C(8-B)Tx
Mcu.Package=LQFP48
NVIC.PriorityGroup=NVIC_PRIORITYGROUP_4
ProjectManager.HeapSize=0x200
ProjectManager.StackSize=0x400
ProjectManager.TargetToolchain=STM32CubeIDE
RCC.APB1Freq_Value=8000000
RCC.APB2Freq_Value=8000000
board=custom

// file: Core/Src/main.c
/* USER CODE BEGIN Header */
/**
  ******************************************************************************
  * @file           : main.c
  * @brief          : Main program body
  ******************************************************************************
  * @attention
  *
  * Copyright (c) 2026 STMicroelectronics.
  * All rights reserved.
  *
  * This software is licensed under terms that can be found in the LICENSE file
  * in the root directory of this software component.
  * If no LICENSE file comes with this software, it is provided AS-IS.
  *
  ******************************************************************************
  */
/* USER CODE END Header */
#include "main.h"

/* USER CODE BEGIN PD */
#define APP_START_ADDR  0x08004000   // Application flash start
#define APP_SIZE_WORDS  (48 * 1024 / 4) // 48 KB application size

/* USER CODE END PD */

void SystemClock_Config(void);
/* USER CODE BEGIN PFP */

uint32_t calculate_checksum(uint32_t *data, uint32_t length);
void jump_to_application(void);

/* USER CODE END PFP */

/* USER CODE BEGIN 0 */

uint32_t calculate_checksum(uint32_t *data, uint32_t length)
{
    uint32_t checksum = 0;

    for (uint32_t i = 0; i < length; i++)
    {
        checksum ^= data[i];
    }

    return checksum;
}

typedef void (*pFunction)(void);

void jump_to_application(void)
{
    uint32_t appStack = *(volatile uint32_t*)APP_START_ADDR;
    uint32_t appReset = *(volatile uint32_t*)(APP_START_ADDR + 4);

    pFunction appResetHandler = (pFunction)appReset;

    __disable_irq();
    __set_MSP(appStack);
    appResetHandler();
}
/* USER CODE END 0 */

int main(void)
{

  /* MCU Configuration--------------------------------------------------------*/

  /* Reset of all peripherals, Initializes the Flash interface and the Systick. */
  HAL_Init();

  /* Configure the system clock */
  SystemClock_Config();

  /* Initialize all configured peripherals */
  /* USER CODE BEGIN 2 */

  uint32_t calculated_checksum;
  uint32_t expected_checksum = 0x12345678;  // dummy trusted value

  calculated_checksum = calculate_checksum(
      (uint32_t*)APP_START_ADDR,
      APP_SIZE_WORDS
  );

  if (calculated_checksum == expected_checksum)
  {
      jump_to_application();
  }
  else
  {
      // Firmware tampered or missing
      while (1)
      {
          // Stay here (attack detected)
      }
  }

  /* USER CODE END 2 */

  /* Infinite loop */

}

void SystemClock_Config(void)
{
  RCC_OscInitTypeDef RCC_OscInitStruct = {0};
  RCC_ClkInitTypeDef RCC_ClkInitStruct = {0};

  /** Initializes the RCC Oscillators according to the specified parameters
  * in the RCC_OscInitTypeDef structure.
  */
  RCC_OscInitStruct.OscillatorType = RCC_OSCILLATORTYPE_HSI;
  RCC_OscInitStruct.HSIState = RCC_HSI_ON;
  RCC_OscInitStruct.HSICalibrationValue = RCC_HSICALIBRATION_DEFAULT;
  RCC_OscInitStruct.PLL.PLLState = RCC_PLL_NONE;
  if (HAL_RCC_OscConfig(&RCC_OscInitStruct) != HAL_OK)
  {
    Error_Handler();
  }

  /** Initializes the CPU, AHB and APB buses clocks
  */
  RCC_ClkInitStruct.ClockType = RCC_CLOCKTYPE_HCLK|RCC_CLOCKTYPE_SYSCLK
                              |RCC_CLOCKTYPE_PCLK1|RCC_CLOCKTYPE_PCLK2;
  RCC_ClkInitStruct.SYSCLKSource = RCC_SYSCLKSOURCE_HSI;
  RCC_ClkInitStruct.AHBCLKDivider = RCC_SYSCLK_DIV1;
  RCC_ClkInitStruct.APB1CLKDivider = RCC_HCLK_DIV1;
  RCC_ClkInitStruct.APB2CLKDivider = RCC_HCLK_DIV1;

  if (HAL_RCC_ClockConfig(&RCC_ClkInitStruct, FLASH_LATENCY_0) != HAL_OK)
  {
    Error_Handler();
  }
}

void Error_Handler(void)
{
  __disable_irq();
  while (1)
  {
  }
}
